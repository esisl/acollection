/*
   Воспроизведение 4-битного звука на Arduino Nano
   Частота: 8000 Гц
   Длина: 4.0 сек
   Размер: 16000 байт
*/

#include <avr/pgmspace.h>
// Упакованные данные: 2 семпла на байт (4 бита каждый)
const unsigned char sound_data[] PROGMEM = {
  0x88, 0x88, 0x88, 0x88, 0x88, 0x88, 0x88, 0x88, 0x88, 0x88, 0x88, 0x88, 0x88, 0x88, 0x88, 0x88,
  0x88, 0x88, 0x88, 0x88, 0x88, 0x88, 0x88, 0x88, 0x88, 0x88, 0x88, 0x88, 0x88, 0x88, 0x88, 0x88,
  0x88, 0x88, 0x88, 0x88, 0x88, 0xFF, 0xFF, 0xFF, 0xFF, 0xFF, 0xFF, 0xFF, 0xFF, 0xFF, 0xFF, 0xFF,
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  0xFF, 0xFF, 0x88, 0x88, 0x88, 0x88, 0x88, 0x88, 0x88, 0x88, 0x88, 0x88, 0x88, 0x88, 0x88, 0x88
};

const int speakerPin = 3;  // ШИМ-пин (D3, D5, D6, D9, D10, D11)
const int data_size = 16000;
const int sample_rate = 8000;  // Гц


   // Пины для подключения L298N
const int ENA = 3;
const int IN1 = 5;
const int IN2 = 6;
const int ENB = 10;
const int IN3 = 2;
const int IN4 = 4;

const int trigPin = 9;
const int echoPin = 10;

void setup() {
  // Настройка таймера 2 на высокую частоту ШИМ (~62.5 кГц)
  TCCR2A = _BV(COM2A1) | _BV(COM2B1) | _BV(WGM21) | _BV(WGM20);
  TCCR2B = _BV(CS20);  // No prescaler
 // Настройка пинов на выход
 pinMode(ENA, OUTPUT);
 pinMode(ENB, OUTPUT);
 pinMode(IN1, OUTPUT);
 pinMode(IN2, OUTPUT);
 pinMode(IN3, OUTPUT);
 pinMode(IN4, OUTPUT);
 
  digitalWrite(IN1, HIGH);
  digitalWrite(IN2, LOW);

  digitalWrite(IN3, LOW);
  digitalWrite(IN4, LOW);
  //analogWrite(ENA, 255);
  //analogWrite(ENB, 255);
  
  pinMode(speakerPin, OUTPUT);

  pinMode(trigPin, OUTPUT);  
  pinMode(echoPin, INPUT);  
}

void loop() {
  delay(500);
  digitalWrite(trigPin, LOW);  
  delayMicroseconds(2);  
  digitalWrite(trigPin, HIGH);  
  delayMicroseconds(10);  
  digitalWrite(trigPin, LOW);  
  long duration = pulseIn(echoPin, HIGH);  
  int distance = duration * 0.034 / 2;

  if(distance < 40){
    playSound();
    digitalWrite(IN3, LOW);
    for(int i = 0; i < 100;i++){
    digitalWrite(IN4, HIGH);
    delay(70);
    digitalWrite(IN4, LOW);
    delay(70);
    }
    digitalWrite(IN4, HIGH);
    delay(2000);
    digitalWrite(IN4, LOW);
  }
}

void playSound() {
  unsigned long next_time = micros();
  const long half_sample_us = 1000000L / sample_rate;// / 2;  // 62.5 мкс

  for (int i = 0; i < data_size; i++) {
    byte current_byte = pgm_read_byte(&sound_data[i]);

    // Первый семпл
    byte s1 = (current_byte >> 4) & 0x0F;
    analogWrite(speakerPin, s1 << 4);  // 0-15 -> 0-240
    next_time += half_sample_us;
    while (micros() < next_time);

    // Второй семпл
    byte s2 = current_byte & 0x0F;
    analogWrite(speakerPin, s2 << 4);
    next_time += half_sample_us;
    while (micros() < next_time);
  }
  digitalWrite(speakerPin, LOW);
}
